## src/ultrasonic/yocto-playground/build/conf/bblayers.conf
```bitbake
# https://github.com/FrankBau/raspi-repo-manifest/wiki/bblayers.conf

# POKY_BBLAYERS_CONF_VERSION is increased each time build/conf/bblayers.conf
# changes incompatibly
POKY_BBLAYERS_CONF_VERSION = "2"

BBPATH = "${TOPDIR}"
BBFILES ?= ""

# BBLAYERS ?= " \
#   /home/ika/gits/_htw/2022ws_team3/ultrasonic/yocto-playground/recipes/poky/meta \
#   /home/ika/gits/_htw/2022ws_team3/ultrasonic/yocto-playground/recipes/poky/meta-poky \
#   /home/ika/gits/_htw/2022ws_team3/ultrasonic/yocto-playground/recipes/poky/meta-yocto-bsp \
#   "


YOCTOROOT = "${@os.path.abspath(os.path.join("${TOPDIR}", os.pardir))}"

BBLAYERS ?= " \
  ${YOCTOROOT}/recipes/poky/meta \
  ${YOCTOROOT}/recipes/poky/meta-poky \
  ${YOCTOROOT}/recipes/poky/meta-yocto-bsp \
  \
  ${YOCTOROOT}/recipes/meta-openembedded/meta-oe \
  ${YOCTOROOT}/recipes/meta-openembedded/meta-multimedia \
  ${YOCTOROOT}/recipes/meta-openembedded/meta-networking \
  ${YOCTOROOT}/recipes/meta-openembedded/meta-webserver \
  ${YOCTOROOT}/recipes/meta-openembedded/meta-python \
  \
  ${YOCTOROOT}/recipes/meta-qt5 \
  \
  ${YOCTOROOT}/recipes/meta-raspberrypi \
  \
  ${YOCTOROOT}/recipes/meta-raspberrypi-avg \
"
```
